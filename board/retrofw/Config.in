## board/retrofw/Config.in
```kconfig
menu "RetroFW packages"
	source "$BR2_EXTERNAL_RETROFW_PATH/package/libini/Config.in"
	source "$BR2_EXTERNAL_RETROFW_PATH/package/libopk/Config.in"
	source "$BR2_EXTERNAL_RETROFW_PATH/package/libmikmod/Config.in"
	source "$BR2_EXTERNAL_RETROFW_PATH/package/mininit/Config.in"
	source "$BR2_EXTERNAL_RETROFW_PATH/package/timidity/Config.in"
	source "$BR2_EXTERNAL_RETROFW_PATH/package/recovery/Config.in"
	source "$BR2_EXTERNAL_RETROFW_PATH/package/gmenunx/Config.in"
endmenu
```

## board/retrofw/package/gmenunx/Config.in
```kconfig
config BR2_PACKAGE_GMENUNX
        bool "GMenuNX"
        default y
        select BR2_PACKAGE_SDL
        select BR2_PACKAGE_SDL_IMAGE
        select BR2_PACKAGE_SDL_TTF
        help
          https://github.com/retrofw/gmenunx
```

## board/retrofw/package/mininit/Config.in
```kconfig
config BR2_PACKAGE_MININIT
	bool "mininit"
    default y
	help
	  Initial Linux process that performs a loopback mount of the actual rootfs

	  https://github.com/OpenDingux/mininit
```

## board/retrofw/package/recovery/Config.in
```kconfig
config BR2_PACKAGE_RECOVERY
        bool "RetroFW Recovery"
        default y
        select BR2_PACKAGE_SDL
        select BR2_PACKAGE_SDL_IMAGE
        select BR2_PACKAGE_SDL_TTF
        help
          https://github.com/retrofw/recovery
```

## package/fatresize/Config.in
```kconfig
config BR2_PACKAGE_FATRESIZE
	bool "fatresize"
	select BR2_PACKAGE_UTIL_LINUX
	select BR2_PACKAGE_PARTED
	help
	  parted, the GNU partition resizing program

	  http://www.gnu.org/software/parted/

comment "parted needs a toolchain w/ wchar"
	depends on !BR2_USE_WCHAR
```

## package/fatresize/Config.in.host
```kconfig
config BR2_PACKAGE_HOST_FATRESIZE
	bool "host fatresize"
	help
	  parted, the GNU partition resizing program

	  http://www.gnu.org/software/parted/
```

## retrofw/Config.in
```kconfig
menu "RetroFW packages"
	source "$BR2_EXTERNAL_RETROFW_PATH/package/libini/Config.in"
	source "$BR2_EXTERNAL_RETROFW_PATH/package/libopk/Config.in"
	source "$BR2_EXTERNAL_RETROFW_PATH/package/libmikmod/Config.in"
endmenu
```

## retrofw/configs/RetroFW_defconfig
```kconfig
BR2_mipsel=y
# BR2_MIPS_SOFT_FLOAT is not set
BR2_MIPS_FP32_MODE_32=y
BR2_SVN="svn"
BR2_CCACHE=y
BR2_OPTIMIZE_2=y
BR2_TOOLCHAIN_BUILDROOT_VENDOR="RetroFW"
BR2_KERNEL_HEADERS_3_2=y
BR2_TOOLCHAIN_BUILDROOT_WCHAR=y
BR2_PTHREAD_DEBUG=y
BR2_BINUTILS_VERSION_2_30_X=y
BR2_GCC_VERSION_7_X=y
BR2_TOOLCHAIN_BUILDROOT_CXX=y
BR2_PACKAGE_HOST_GDB=y
BR2_TARGET_OPTIMIZATION="-mips32"
BR2_TARGET_GENERIC_HOSTNAME="retrofw"
BR2_TARGET_GENERIC_ISSUE="Welcome to RetroFW"
BR2_ROOTFS_DEVICE_CREATION_DYNAMIC_MDEV=y
# BR2_TARGET_GENERIC_REMOUNT_ROOTFS_RW is not set
BR2_ROOTFS_OVERLAY="$(BR2_EXTERNAL_RETROFW_PATH)/board/rootfs_overlay"
BR2_ROOTFS_POST_FAKEROOT_SCRIPT="$(BR2_EXTERNAL_RETROFW_PATH)/board/retrofw.sh"
BR2_PACKAGE_MPG123=y
BR2_PACKAGE_BZIP2=y
BR2_PACKAGE_LZ4=y
BR2_PACKAGE_P7ZIP=y
BR2_PACKAGE_UNRAR=y
BR2_PACKAGE_ZIP=y
BR2_PACKAGE_GDB=y
BR2_PACKAGE_GDB_SERVER=y
BR2_PACKAGE_GDB_DEBUGGER=y
BR2_PACKAGE_KEXEC=y
BR2_PACKAGE_KEXEC_ZLIB=y
BR2_PACKAGE_STRACE=y
BR2_PACKAGE_VALGRIND=y
BR2_PACKAGE_GETTEXT=y
BR2_PACKAGE_LIBTOOL=y
BR2_PACKAGE_CPIO=y
BR2_PACKAGE_DOSFSTOOLS=y
BR2_PACKAGE_DOSFSTOOLS_FATLABEL=y
BR2_PACKAGE_DOSFSTOOLS_FSCK_FAT=y
BR2_PACKAGE_DOSFSTOOLS_MKFS_FAT=y
BR2_PACKAGE_E2FSPROGS=y
BR2_PACKAGE_EXFAT_UTILS=y
BR2_PACKAGE_NTFS_3G=y
BR2_PACKAGE_SQUASHFS=y
BR2_PACKAGE_UNIONFS=y
BR2_PACKAGE_FBGRAB=y
BR2_PACKAGE_FBV=y
BR2_PACKAGE_SDL_GFX=y
BR2_PACKAGE_SDL_IMAGE_GIF=y
BR2_PACKAGE_SDL_IMAGE_LBM=y
BR2_PACKAGE_SDL_IMAGE_PCX=y
BR2_PACKAGE_SDL_IMAGE_PNM=y
BR2_PACKAGE_SDL_IMAGE_TARGA=y
BR2_PACKAGE_SDL_IMAGE_TIFF=y
BR2_PACKAGE_SDL_IMAGE_WEBP=y
BR2_PACKAGE_SDL_IMAGE_XCF=y
BR2_PACKAGE_SDL_IMAGE_XPM=y
BR2_PACKAGE_SDL_IMAGE_XV=y
BR2_PACKAGE_SDL_NET=y
BR2_PACKAGE_SDL_SOUND=y
BR2_PACKAGE_GPTFDISK=y
BR2_PACKAGE_PYTHON=y
BR2_PACKAGE_PYTHON_PYGAME=y
BR2_PACKAGE_PYTHON_PYGAME_IMAGE=y
BR2_PACKAGE_PYTHON_PYGAME_FONT=y
BR2_PACKAGE_PYTHON_PYGAME_MIXER=y
BR2_PACKAGE_PYTHON_PYGAME_MIXER_MUSIC=y
BR2_PACKAGE_PYTHON_SCANDIR=y
BR2_PACKAGE_LIBAO=y
BR2_PACKAGE_LIBASPLIB=y
BR2_PACKAGE_LIBID3TAG=y
BR2_PACKAGE_LIBMAD=y
BR2_PACKAGE_LIBMAD_OPTIMIZATION_SPEED=y
BR2_PACKAGE_LIBMAD_SSO=y
BR2_PACKAGE_LIBMODPLUG=y
BR2_PACKAGE_LIBMIKMOD=y
BR2_PACKAGE_LIBSNDFILE=y
BR2_PACKAGE_LIBVORBIS=y
BR2_PACKAGE_TREMOR=y
BR2_PACKAGE_LIBZIP=y
BR2_PACKAGE_LIBSHA1=y
BR2_PACKAGE_LIBCONFIG=y
BR2_PACKAGE_PHYSFS=y
BR2_PACKAGE_JPEG_TURBO=y
BR2_PACKAGE_LIBPTHREAD_STUBS=y
BR2_PACKAGE_LIBSIGC=y
BR2_PACKAGE_ICU=y
BR2_PACKAGE_NCURSES_WCHAR=y
BR2_PACKAGE_NCURSES_ADDITIONAL_TERMINFO="s/st-256color"
BR2_PACKAGE_POPT=y
BR2_PACKAGE_XUTIL_UTIL_MACROS=y
BR2_PACKAGE_DNSMASQ=y
BR2_PACKAGE_LRZSZ=y
BR2_PACKAGE_OPKG=y
BR2_PACKAGE_UTIL_LINUX_BINARIES=y
BR2_PACKAGE_NANO=y
BR2_PACKAGE_HOST_E2FSPROGS=y
```

## retrofw/package/libini/Config.in
```kconfig
config BR2_PACKAGE_LIBINI
	bool "libini"
    default y
	help
	  Tiny library to help reading INI files.

	  https://github.com/pcercuei/libini
```

## retrofw/package/libopk/Config.in
```kconfig
config BR2_PACKAGE_LIBOPK
        bool "libopk"
        default y
        select BR2_PACKAGE_ZLIB
        select BR2_PACKAGE_LIBINI
        help
          Library to handle OPK packages.

          https://github.com/pcercuei/libopk
```

## retrofw/package/timidity/Config.in
```kconfig
config BR2_PACKAGE_TIMIDITY
        bool "timidity"
        default y
        help
          https://github.com/retrofw/timidity
```
